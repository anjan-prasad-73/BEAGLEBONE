/dts-v1/;
/plugin/;

/ {
    compatible = "ti,beaglebone", "ti,beaglebone-black";

    fragment@0 {
        target = <&i2c2>;
        __overlay__ {
            status = "okay";

            my_i2c_dev@50 {
                compatible = "bb,my-i2c-dev";
                reg = <0x50>;   /* I2C slave address */
            };
        };
    };
};

