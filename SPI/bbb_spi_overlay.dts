/dts-v1/;
/plugin/;

/ {
    compatible = "ti,beaglebone", "ti,beaglebone-black";

    /* Enable SPI1 */
    fragment@0 {
        target = <&spi1>;
        __overlay__ {
            status = "okay";

            bb_spi_dev@0 {
                compatible = "bb,spi-device";
                reg = <0>;              /* CS0 */
                spi-max-frequency = <1000000>;
            };
        };
    };
};

