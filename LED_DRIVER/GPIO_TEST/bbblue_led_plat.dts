/dts-v1/;
/plugin/;

/ {
    compatible = "ti,beaglebone";

    fragment@0 {
        target-path = "/";
        __overlay__ {
            board_led: board_led {
                compatible = "bbblue,board-led";
                gpios = <&gpio1 17 0>;   /* 0 = GPIO_ACTIVE_HIGH */
                status = "okay";
            };
        };
    };
};

